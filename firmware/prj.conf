## CMakeLists.txt
```
cmake_minimum_required(VERSION 3.20.0)

find_package(Zephyr REQUIRED HINTS $ENV{ZEPHYR_BASE})
project(rtt_feedback)

target_sources(app PRIVATE src/main.c)
```

## prj.conf
```kconfig
CONFIG_USE_SEGGER_RTT=y

CONFIG_LOG=y
CONFIG_LOG_BACKEND_RTT=y
CONFIG_LOG_BACKEND_UART=n
CONFIG_PRINTK=n
CONFIG_LOG_PRINTK=n
CONFIG_UART_CONSOLE=n
CONFIG_CONSOLE=n

CONFIG_BUILD_OUTPUT_UF2=n
CONFIG_USE_DT_CODE_PARTITION=n

CONFIG_SERIAL=y
CONFIG_UART_INTERRUPT_DRIVEN=y

CONFIG_ENTROPY_GENERATOR=y
```

## boards/xiao_ble_nrf52840_sense.overlay
```dts
/ {
	chosen {
		zephyr,console = &xiao_serial;
		zephyr,shell-uart = &xiao_serial;
	};
};
```

## src/main.c
```c
#include <ctype.h>
#include <errno.h>
#include <limits.h>
#include <stdbool.h>
#include <stdarg.h>
#include <stdint.h>
#include <stdio.h>
#include <stdlib.h>
#include <string.h>

#include <zephyr/devicetree.h>
#include <zephyr/device.h>
#include <zephyr/drivers/uart.h>
#include <zephyr/kernel.h>
#include <zephyr/logging/log.h>
#include <zephyr/random/random.h>
#include <zephyr/sys/ring_buffer.h>
#include <zephyr/sys/util.h>

LOG_MODULE_REGISTER(rtt_feedback, LOG_LEVEL_INF);

#define CLI_LINE_LEN 128
#define CLI_ARG_MAX 8
#define CLI_RX_BUF_SIZE 256

static const struct device *const cli_uart = DEVICE_DT_GET(DT_CHOSEN(zephyr_shell_uart));

RING_BUF_DECLARE(cli_rx_ringbuf, CLI_RX_BUF_SIZE);

static bool counter_running = true;
static uint32_t counter_value;
static uint32_t rx_byte_count;

static const char spam_hex_table[] = "0123456789abcdef";

static bool spam_running;
static uint32_t spam_remaining;
static bool spam_hex;
static uint32_t spam_delay_ms;
static char spam_last_data[64];
static bool spam_delay_active;
static int64_t spam_next_packet;
static uint32_t spam_sent;

static void cli_write(const char *text)
{
	for (size_t i = 0; text[i] != '\0'; i++) {
		uart_poll_out(cli_uart, text[i]);
	}
}

static void cli_printf(const char *fmt, ...)
{
	char buf[192];
	va_list args;

	va_start(args, fmt);
	vsnprintf(buf, sizeof(buf), fmt, args);
	va_end(args);

	cli_write(buf);
}

static void cli_prompt(void)
{
	cli_write("> ");
}

static bool parse_long(const char *text, long *value)
{
	char *end = NULL;
	long parsed;

	errno = 0;
	parsed = strtol(text, &end, 10);
	if (errno != 0 || end == text || *end != '\0') {
		return false;
	}

	*value = parsed;
	return true;
}

static size_t split_args(char *line, char **argv, size_t max_args)
{
	size_t argc = 0;
	char *p = line;

	while (*p != '\0' && argc < max_args) {
		while (isspace((unsigned char)*p)) {
			p++;
		}

		if (*p == '\0') {
			break;
		}

		if (*p == '"') {
			p++;
			argv[argc++] = p;
			while (*p != '\0' && *p != '"') {
				p++;
			}
			if (*p == '"') {
				*p++ = '\0';
			}
		} else {
			argv[argc++] = p;
			while (*p != '\0' && !isspace((unsigned char)*p)) {
				p++;
			}
			if (*p != '\0') {
				*p++ = '\0';
			}
		}
	}

	return argc;
}

static void cmd_help(void)
{
	cli_write(
		"Commands:\r\n"
		"  help\r\n"
		"  ping\r\n"
		"  echo <text>\r\n"
		"  count <start> <end>\r\n"
		"  counter [on|off]\r\n"
		"  uptime\r\n"
		"  info\r\n"
		"  delay <ms>\r\n"
		"  rand [min] [max]\r\n"
		"  spam <bytes> [format=binary] [last_data=\"\\r\\n\"] [delay=10]\r\n"
		"    format: hex (0-9a-f chars) or binary (raw uint8_t)\r\n"
		"    last_data: suffix printed after all packets (supports \\\\r \\\\n \\\\t \\\\)\r\n"
		"    delay: ms between 256-byte packets (min 1ms)\r\n"
		"  spam stop\r\n");
}

static void cmd_ping(void)
{
	cli_write("pong\r\n");
}

static void cmd_echo(size_t argc, char **argv)
{
	if (argc < 2U) {
		cli_write("Usage: echo <text>\r\n");
		return;
	}

	for (size_t i = 1; i < argc; i++) {
		cli_write(argv[i]);
		if (i + 1U < argc) {
			cli_write(" ");
		}
	}
	cli_write("\r\n");
}

static void cmd_count(size_t argc, char **argv)
{
	long start;
	long end;

	if (argc != 3U) {
		cli_write("Usage: count <start> <end>\r\n");
		return;
	}

	if (!parse_long(argv[1], &start) || !parse_long(argv[2], &end)) {
		cli_write("Invalid number\r\n");
		return;
	}

	if (start <= end) {
		for (long i = start; i <= end; i++) {
			cli_printf("%ld\r\n", i);
			k_msleep(100);
		}
	} else {
		for (long i = start; i >= end; i--) {
			cli_printf("%ld\r\n", i);
			k_msleep(100);
		}
	}
}

static void cmd_counter(size_t argc, char **argv)
{
	if (argc == 1U) {
		cli_printf("Counter %s, value %u\r\n",
			counter_running ? "running" : "stopped", counter_value);
		return;
	}

	if (argc != 2U) {
		cli_write("Usage: counter [on|off]\r\n");
		return;
	}

	if (strcmp(argv[1], "on") == 0) {
		counter_running = true;
		cli_write("Counter started\r\n");
		return;
	}

	if (strcmp(argv[1], "off") == 0) {
		counter_running = false;
		cli_write("Counter stopped\r\n");
		return;
	}

	cli_write("Usage: counter [on|off]\r\n");
}

static void cmd_uptime(void)
{
	uint32_t uptime = k_uptime_get_32();

	cli_printf("Uptime: %u ms\r\n", uptime);
	cli_printf("Uptime: %u.%03u s\r\n", uptime / 1000U, uptime % 1000U);
}

static void cmd_info(void)
{
	cli_printf("Board: %s\r\n", CONFIG_BOARD_TARGET);
	cli_printf("Build time: %s %s\r\n", __DATE__, __TIME__);
}

static void cmd_delay(size_t argc, char **argv)
{
	long ms;

	if (argc != 2U) {
		cli_write("Usage: delay <ms>\r\n");
		return;
	}

	if (!parse_long(argv[1], &ms) || ms < 0) {
		cli_write("Invalid number\r\n");
		return;
	}

	cli_printf("Delaying for %ld ms...\r\n", ms);
	k_msleep((uint32_t)ms);
	cli_write("Done\r\n");
}

static void cmd_rand(size_t argc, char **argv)
{
	long min = 0;
	long max = 100;

	if (argc >= 2U && !parse_long(argv[1], &min)) {
		cli_write("Invalid min\r\n");
		return;
	}

	if (argc >= 3U && !parse_long(argv[2], &max)) {
		cli_write("Invalid max\r\n");
		return;
	}

	if (max < min) {
		cli_write("Invalid range\r\n");
		return;
	}

	cli_printf("Random [%ld-%ld]: %ld\r\n", min, max,
		min + (long)(sys_rand32_get() % (uint32_t)(max - min + 1L)));
}

static size_t unescape_string(const char *src, char *dst, size_t dst_len)
{
	size_t out = 0;

	while (*src != '\0' && out < dst_len - 1U) {
		if (*src == '\\' && *(src + 1) != '\0') {
			src++;
			switch (*src) {
			case 'r':
				dst[out++] = '\r';
				break;
			case 'n':
				dst[out++] = '\n';
				break;
			case 't':
				dst[out++] = '\t';
				break;
			case '\\':
				dst[out++] = '\\';
				break;
			default:
				dst[out++] = '\\';
				if (out < dst_len - 1U) {
					dst[out++] = *src;
				}
				break;
			}
		} else {
			dst[out++] = *src;
		}
		src++;
	}

	dst[out] = '\0';
	return out;
}

static void spam_tick(void)
{
	if (!spam_running) {
		return;
	}

	if (spam_delay_active) {
		if (k_uptime_get() < spam_next_packet) {
			return;
		}
		spam_delay_active = false;
	}

	while (spam_running && spam_remaining > 0U && !spam_delay_active) {
		uint32_t pkt = MIN(spam_remaining, 256U);

		for (uint32_t i = 0U; i < pkt && spam_running; i++) {
			uint8_t b;

			if (spam_hex) {
				b = (uint8_t)spam_hex_table[sys_rand32_get() % 16U];
			} else {
				b = (uint8_t)(sys_rand32_get() & 0xFFU);
			}

			uart_poll_out(cli_uart, b);
		}

		spam_remaining -= pkt;
		spam_sent += pkt;

		if (spam_remaining > 0U && spam_running) {
			spam_delay_active = true;
			spam_next_packet = k_uptime_get() + (int64_t)spam_delay_ms;
			return;
		}
	}

	if (spam_running) {
		cli_write(spam_last_data);
		cli_printf("Spam complete: %u bytes sent\r\n", spam_sent);
	} else {
		cli_printf("Spam stopped: %u bytes sent\r\n", spam_sent);
	}

	spam_running = false;
	cli_prompt();
}

static void cmd_spam(size_t argc, char **argv)
{
	if (argc >= 2U && strcmp(argv[1], "stop") == 0) {
		if (!spam_running) {
			cli_write("Spam not running\r\n");
			return;
		}
		spam_running = false;
		return;
	}

	if (argc < 2U) {
		cli_write("Usage: spam <bytes> [format=binary] [last_data=\"\\r\\n\"] [delay=10]\r\n");
		return;
	}

	long bytes_val;

	if (!parse_long(argv[1], &bytes_val) || bytes_val < 0L) {
		cli_write("Invalid bytes value\r\n");
		return;
	}

	bool hex = false;

	if (argc >= 3U) {
		if (strcmp(argv[2], "hex") == 0) {
			hex = true;
		} else if (strcmp(argv[2], "binary") != 0) {
			cli_write("Format must be 'hex' or 'binary'\r\n");
			return;
		}
	}

	char last_data[64] = "\\r\\n";

	if (argc >= 4U) {
		unescape_string(argv[3], last_data, sizeof(last_data));
	}

	long delay_val = 10L;

	if (argc >= 5U) {
		if (!parse_long(argv[4], &delay_val)) {
			cli_write("Invalid delay value\r\n");
			return;
		}
	}

	if (delay_val < 1L) {
		delay_val = 1L;
	}

	spam_running = true;
	spam_remaining = (uint32_t)bytes_val;
	spam_hex = hex;
	spam_delay_ms = (uint32_t)delay_val;
	strncpy(spam_last_data, last_data, sizeof(spam_last_data) - 1U);
	spam_last_data[sizeof(spam_last_data) - 1U] = '\0';
	spam_delay_active = false;
	spam_sent = 0U;

	cli_printf("Spamming %u bytes (%s, delay=%ums)\r\n",
		spam_remaining, spam_hex ? "hex" : "binary", spam_delay_ms);
}

static void process_command(char *line)
{
	char *argv[CLI_ARG_MAX];
	size_t argc;

	argc = split_args(line, argv, ARRAY_SIZE(argv));
	if (argc == 0U) {
		return;
	}

	if (strcmp(argv[0], "help") == 0) {
		cmd_help();
	} else if (strcmp(argv[0], "ping") == 0) {
		cmd_ping();
	} else if (strcmp(argv[0], "echo") == 0) {
		cmd_echo(argc, argv);
	} else if (strcmp(argv[0], "count") == 0) {
		cmd_count(argc, argv);
	} else if (strcmp(argv[0], "counter") == 0) {
		cmd_counter(argc, argv);
	} else if (strcmp(argv[0], "uptime") == 0) {
		cmd_uptime();
	} else if (strcmp(argv[0], "info") == 0) {
		cmd_info();
	} else if (strcmp(argv[0], "delay") == 0) {
		cmd_delay(argc, argv);
	} else if (strcmp(argv[0], "rand") == 0) {
		cmd_rand(argc, argv);
	} else if (strcmp(argv[0], "spam") == 0) {
		cmd_spam(argc, argv);
	} else {
		cli_write("Unknown command. Type 'help'.\r\n");
	}
}

static void cli_uart_isr(const struct device *dev, void *user_data)
{
	uint8_t buf[32];
	int rx;

	ARG_UNUSED(user_data);

	if (!uart_irq_update(dev)) {
		return;
	}

	while (uart_irq_rx_ready(dev)) {
		rx = uart_fifo_read(dev, buf, sizeof(buf));
		if (rx <= 0) {
			break;
		}

		(void)ring_buf_put(&cli_rx_ringbuf, buf, (uint32_t)rx);
		rx_byte_count += (uint32_t)rx;
	}
}

static void process_rx_bytes(void)
{
	static char line[CLI_LINE_LEN];
	static size_t len;
	uint8_t ch;

	while (ring_buf_get(&cli_rx_ringbuf, &ch, 1U) == 1U) {
		if (ch == '\r' || ch == '\n') {
			cli_write("\r\n");
			line[len] = '\0';
			process_command(line);
			len = 0;
			cli_prompt();
			continue;
		}

		if ((ch == '\b' || ch == 0x7fU) && len > 0U) {
			len--;
			cli_write("\b \b");
			continue;
		}

		if (isprint(ch) && len < (CLI_LINE_LEN - 1U)) {
			line[len++] = (char)ch;
			uart_poll_out(cli_uart, ch);
		}
	}
}

int main(void)
{
	int64_t next_tick = k_uptime_get() + 1000;

	if (!device_is_ready(cli_uart)) {
		LOG_ERR("UART device not ready");
		return 0;
	}

	uart_irq_callback_user_data_set(cli_uart, cli_uart_isr, NULL);
	uart_irq_rx_enable(cli_uart);

	LOG_INF("RTT feedback firmware started.");
	LOG_INF("Board: %s", CONFIG_BOARD_TARGET);
	cli_write("\r\nSimple UART CLI ready. Type 'help'.\r\n");
	cli_prompt();

	while (1) {
		process_rx_bytes();

		if (counter_running && k_uptime_get() >= next_tick) {
			LOG_INF("Tick: %u rx:%u", counter_value, rx_byte_count);
			counter_value++;
			next_tick += 1000;
		}

		spam_tick();

		k_msleep(1);
	}

	return 0;
}
```
